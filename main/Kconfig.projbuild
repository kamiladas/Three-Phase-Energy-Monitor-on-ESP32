## main/Kconfig.projbuild
```kconfig
menu "Energy Monitor"

choice EM_SAMPLE_SOURCE
    prompt "Sample source"
    default EM_SAMPLE_SOURCE_SIM

config EM_SAMPLE_SOURCE_SIM
    bool "Deterministic simulator (QEMU)"

config EM_SAMPLE_SOURCE_ADC
    bool "ESP32 ADC1 continuous mode (hardware)"

endchoice

endmenu
```

## sdkconfig.defaults
```kconfig
CONFIG_IDF_TARGET="esp32"
CONFIG_COMPILER_CXX_EXCEPTIONS=n
CONFIG_COMPILER_CXX_RTTI=n
CONFIG_ESP_TASK_WDT_EN=y
CONFIG_ESP_TASK_WDT_INIT=y
CONFIG_ESP_MAIN_TASK_STACK_SIZE=4096
CONFIG_LOG_DEFAULT_LEVEL_INFO=y
CONFIG_EM_SAMPLE_SOURCE_SIM=y
CONFIG_EXAMPLE_CONNECT_ETHERNET=y
CONFIG_ETH_USE_OPENETH=y
# CONFIG_ETHERNET_INTERNAL_SUPPORT is not set
CONFIG_ETHERNET_OPENETH_SUPPORT=y
CONFIG_EXAMPLE_CONNECT_IPV4=y
CONFIG_EXAMPLE_CONNECT_IPV6=n
CONFIG_EXAMPLE_CONNECT_WIFI=n
# CONFIG_ETH_USE_SPI_ETHERNET is not set
# CONFIG_ETH_USE_ESP32_EMAC is not set
```
